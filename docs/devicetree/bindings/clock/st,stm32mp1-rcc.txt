## docs/devicetree/bindings/clock/st,stm32mp1-rcc.txt
```
STMicroelectronics STM32 Peripheral Reset Clock Controller
==========================================================

The RCC IP is both a reset and a clock controller.

RCC makes also power management (resume/supend and wakeup interrupt).

Please also refer to reset.txt for common reset controller binding usage.

Please also refer to clock-bindings.txt for common clock controller
binding usage.


Required properties:
- compatible: "st,stm32mp1-rcc", "syscon"
- reg: should be register base and length as documented in the datasheet
- #clock-cells: 1, device nodes should specify the clock in their
  "clocks" property, containing a phandle to the clock device node,
  an index specifying the clock to use.
- #reset-cells: Shall be 1
- interrupts: Should contain a general interrupt line and a interrupt line
  to the wake-up of processor (CSTOP).

Example:
	rcc: rcc@50000000 {
		compatible = "st,stm32mp1-rcc", "syscon";
		reg = <0x50000000 0x1000>;
		#clock-cells = <1>;
		#reset-cells = <1>;
		interrupts = <GIC_SPI 5 IRQ_TYPE_NONE>,
			     <GIC_SPI 145 IRQ_TYPE_NONE>;
	};

Other properties:
- secure-status: Relates to RCC TZ_ENABLE configuration to restrict RCC access.
- st,clksrc : The clock sources configuration array in a platform specific order.
- st,clkdiv : The clock dividers configuration array in a paltform specific order.
- st,pll : A specific PLL configuration
- st,pkcs : The peripheral kernel clock distribution configuration array.

Specifying clocks
=================

All available clocks are defined as preprocessor macros in
dt-bindings/clock/stm32mp1-clks.h header and can be used in device
tree sources.

Specifying softreset control of devices
=======================================

Device nodes should specify the reset channel required in their "resets"
property, containing a phandle to the reset device node and an index specifying
which channel to use.
The index is the bit number within the RCC registers bank, starting from RCC
base address.
It is calculated as: index = register_offset / 4 * 32 + bit_offset.
Where bit_offset is the bit offset within the register.

For example on STM32MP1, for LTDC reset:
 ltdc = APB4_RSTSETR_offset / 4 * 32 + LTDC_bit_offset
      = 0x180 / 4 * 32 + 0 = 3072

The list of valid indices for STM32MP1 is available in:
include/dt-bindings/reset-controller/stm32mp1-resets.h

This file implements defines like:
#define LTDC_R	3072


Defining clock source distribution with property st,clksrc
==========================================================

Property can be used to configure the clock distribution tree.
When used, it shall describe the whole distribution tree.

For the STM32MP15x family there are 9 clock sources selector which are
configured in the following order:
	MPU AXI MCU PLL12 PLL3 PLL4 RTC MCO1 MCO2

Clock source configuration values are defined by macros CLK_<NAME>_<SOURCE>
from dt-bindings/clock/stm32mp1-clksrc.h.

Example:
        st,clksrc = <
                CLK_MPU_PLL1P
                CLK_AXI_PLL2P
                CLK_MCU_PLL3P
                CLK_PLL12_HSE
                CLK_PLL3_HSE
                CLK_PLL4_HSE
                CLK_RTC_LSE
                CLK_MCO1_DISABLED
                CLK_MCO2_DISABLED
        >;


Defining clock dividers with property st,clkdiv
===============================================

Property can be used to configure the clock main dividers value.
When used, it shall describe the whole clock dividers tree.

For the STM32MP15x family there are 11 dividers values expected.
They shall be configured in the following order:
	MPU AXI MCU APB1 APB2 APB3 APB4 APB5 RTC MCO1 MCO2

The each divider value uses the DIV coding defined in RCC associated
register RCC_xxxDIVR. In most cases, it is:
		0x0: not divided
		0x1: division by 2
		0x2: division by 4
		0x3: division by 8
		...

Note that for RTC MCO1 MCO2, the coding is different:
		0x0: not divided
		0x1: division by 2
		0x2: division by 3
		0x3: division by 4
		...

Example:
        st,clkdiv = <
                1 /*MPU*/
                0 /*AXI*/
                0 /*MCU*/
                1 /*APB1*/
                1 /*APB2*/
                1 /*APB3*/
                1 /*APB4*/
                2 /*APB5*/
                23 /*RTC*/
                0 /*MCO1*/
                0 /*MCO2*/
        >;

Defining peripheral PLL frequencies with property st,pll
========================================================

This property can be used to configure PLL frequencies.

PLL children nodes for PLL1 to PLL4 (see ref manual for details)
are listed with associated index 0 to 3 (st,pll@0 to st,pll@3).
PLLx is off when the associated node is absent.

Here are the available properties for each PLL node:

- cfg:	The parameters for PLL configuration in the following order:
	DIVM DIVN DIVP DIVQ DIVR Output.

	DIVx values are defined as in RCC spec:
		0x0: bypass (division by 1)
		0x1: division by 2
		0x2: division by 3
		0x3: division by 4
		...

	Output contains a bitfield for each output value (1:ON/0:OFF)
		BIT(0) => output P : DIVPEN
		BIT(1) => output Q : DIVQEN
		BIT(2) => output R : DIVREN
	  NB: macro PQR(p,q,r) can be used to build this value
	      with p,q,r = 0 or 1.

- frac: Fractional part of the multiplication factor
	(optional, PLL is in integer mode when absent).

- csg:	Clock Spreading Generator (optional) with parameters in the following
	order: MOD_PER INC_STEP SSCG_MODE.

	MOD_PER: Modulation Period Adjustment
	INC_STEP: Modulation Depth Adjustment
	SSCG_MODE: Spread spectrum clock generator mode, with associated
		   defined from stm32mp1-clksrc.h:
			- SSCG_MODE_CENTER_SPREAD = 0
			- SSCG_MODE_DOWN_SPREAD = 1

Example:
	st,pll@0 {
		cfg = < 1 53 0 0 0 1 >;
		frac = < 0x810 >;
	};
	st,pll@1 {
		cfg = < 1 43 1 0 0 PQR(0,1,1) >;
		csg = < 10 20 1 >;
	};
	st,pll@2 {
		cfg = < 2 85 3 13 3 0 >;
		csg = < 10 20 SSCG_MODE_CENTER_SPREAD >;
	};
	st,pll@3 {
		cfg = < 2 78 4 7 9 3 >;
	};

Defining peripherals kernel clock tree distribution with property st,pkcs
=========================================================================

This property can be used to configure the peripherals kernel clock selection.

The property is a list of peripheral kernel clock source identifiers defined
by macros CLK_<KERNEL-CLOCK>_<PARENT-CLOCK> as defined by header file
dt-bindings/clock/stm32mp1-clksrc.h.

st,pkcs may not list all the kernel clocks and has no ordering requirements.

Example:
	st,pkcs = <
		CLK_STGEN_HSE
		CLK_CKPER_HSI
		CLK_USBPHY_PLL2P
		CLK_DSI_PLL2Q
                CLK_I2C46_HSI
                CLK_UART1_HSI
                CLK_UART24_HSI
	>;

Fixed clocks description
========================

The clock tree is also based on 5 fixed-clock in clocks node
used to define the state of associated ST32MP1 oscillators:
- clk-lsi
- clk-lse
- clk-hsi
- clk-hse
- clk-csi

At boot the clock tree initialization will
- enable oscillators present in device tree
- disable HSI oscillator if the node is absent (always activated by bootrom)

Optional properties :

a) for external oscillator: "clk-lse", "clk-hse"

	4 optional fields are managed
	- "st,bypass" configures the oscillator bypass mode (HSEBYP, LSEBYP)
	- "st,digbypass" configures the bypass mode as full-swing digital
	  signal (DIGBYP)
	- "st,css" activates the clock security system (HSECSSON, LSECSSON)
	- "st,drive" (only for LSE) contains the value of the drive for the
	   oscillator (see LSEDRV_ defined in the file
	   dt-bindings/clock/stm32mp1-clksrc.h)

	Example board file:

	/ {
		clocks {
			clk_hse: clk-hse {
				#clock-cells = <0>;
				compatible = "fixed-clock";
				clock-frequency = <64000000>;
				st,bypass;
			};

			clk_lse: clk-lse {
				#clock-cells = <0>;
				compatible = "fixed-clock";
				clock-frequency = <32768>;
				st,css;
				st,drive = <LSEDRV_LOWEST>;
			};
	};

b) for internal oscillator: "clk-hsi"

	Internally HSI clock is fixed to 64MHz for STM32MP157 SoC.
	In device tree, clk-hsi is the clock after HSIDIV (clk_hsi in RCC
	doc). So this clock frequency is used to compute the expected HSI_DIV
	for the clock tree initialization.

	Example with HSIDIV = /1:

	/ {
		clocks {
			clk_hsi: clk-hsi {
				#clock-cells = <0>;
				compatible = "fixed-clock";
				clock-frequency = <64000000>;
			};
	};

	Example with HSIDIV = /2

	/ {
		clocks {
			clk_hsi: clk-hsi {
				#clock-cells = <0>;
				compatible = "fixed-clock";
				clock-frequency = <32000000>;
			};
	};

HSI & CSI calibration
========================

Calibration is an optional feature that may be enabled from device tree. It
allows to request calibration of the HSI or the CSI clocks from several means:
	- SiP SMC service
	- Periodic calibration every X seconds
	- Interrupt raised by the MCU

This feature requires that a HW timer is assigned to the calibration sequence.

Dedicated interrupt must be defined using "mcu_sev" name to start a calibration
on detection of an interrupt raised by MCU.

- st,hsi-cal: used to enable HSI clock calibration feature.

- st,csi-cal; used to enable CSI clock calibration feature.

- st,cal-sec: used to enable periodic calibration every specified seconds from
  secure monitor. Time must be given in seconds. If not specified, calibration
  is processed for each incoming request.

Example:
	&rcc {
		st,hsi-cal;
		st,csi-cal;
		st,cal-sec = <15>;
		secure-interrupts = <GIC_SPI 144 IRQ_TYPE_LEVEL_HIGH>,
				<GIC_SPI 145 IRQ_TYPE_LEVEL_HIGH>;
		interrupt-names = "mcu_sev", "wakeup";
	};
```
